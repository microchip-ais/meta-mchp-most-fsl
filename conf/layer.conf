## conf/layer.conf
```bitbake
# We have a conf and classes directory, add to BBPATH
BBPATH .= ":${LAYERDIR}"

# We have recipes-* directories, add to BBFILES
BBFILES += "${LAYERDIR}/recipes-*/*/*.bb \
	${LAYERDIR}/recipes-*/*/*.bbappend"

BBFILE_COLLECTIONS += "mchp-most"
BBFILE_PATTERN_mchp-most = "^${LAYERDIR}/"
BBFILE_PRIORITY_mchp-most = "6"

LAYERDEPENDS_mchp-most = "core fsl-arm fsl-arm-extra"
```
